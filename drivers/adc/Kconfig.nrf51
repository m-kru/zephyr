## drivers/adc/Kconfig.nrf51
```kconfig
# Kconfig - ADC configuration options
#
# Copyright (c) 2017 Nordic Semiconductor ASA
#
# SPDX-License-Identifier: Apache-2.0
#

menuconfig ADC_NRF51
	bool "nRF51 ADC Driver"
	depends on SOC_SERIES_NRF51X && ADC_0
	help
	  Enable driver for nRF51 ADC peripheral.

if ADC_NRF51

choice
	prompt "ADC sample resolution"
	default ADC_NRF51_8_BIT_RES
	help
	  Resolution of ADC samples (sample width).

config ADC_NRF51_8_BIT_RES
	bool "8 bit sample width"

config ADC_NRF51_9_BIT_RES
	bool "9 bit sample width"

config ADC_NRF51_10_BIT_RES
	bool "10 bit sample width"

endchoice

choice
	prompt "ADC input selection"
	default ADC_NRF51_ANG_IN_NO_PRS
	help
	  ADC input source selection.

config ADC_NRF51_ANG_IN_NO_PRS
	bool "Analog input no prescaling"

config ADC_NRF51_ANG_IN_2_3_PRS
	bool "Analog input with two thirds (2/3) prescaling"

config ADC_NRF51_ANG_IN_1_3_PRS
	bool "Analog input with one third (1/3) prescaling"

config ADC_NRF51_VDD_IN_2_3_PRS
	bool "Supply voltage with two thirds (2/3) prescaling"

config ADC_NRF51_VDD_IN_1_3_PRS
	bool "Supply voltage with one third (1/3) prescaling"

endchoice

choice
	prompt "ADC reference selection"
	default ADC_NRF51_VBG_REF
	help
	  ADC reference source selection.

config ADC_NRF51_VBG_REF
	bool "Use internal 1.2 V band gap reference"

config ADC_NRF51_EXT_REF
	bool "Use external reference"

config ADC_NRF51_VDD_1_2_REF
	bool "Use VDD with one half (1/2) prescaling."
	help
	  Only applicable when VDD is in the range 1.7 V - 2.6 V.

config ADC_NRF51_VDD_1_3_REF
	bool "Use VDD with one third (1/3) prescaling."
	help
	  Only applicable when VDD is in the range 2.5 V - 3.6 V.

endchoice

choice
	prompt "External reference pin selection"
	depends on ADC_NRF51_EXT_REF
	default ADC_NRF51_ANG_REF_0
	help
	  ADC external reference pin selection.

config ADC_NRF51_ANG_REF_0
	bool "Use AREF0 as analog reference"

config ADC_NRF51_ANG_REF_1
	bool "Use AREF1 as analog reference"

endchoice

endif # ADC_NRF51
```

## drivers/counter/Kconfig.nrf5
```kconfig
config RTC_NRF5
	bool "nRF5 RTC Driver"
	select NRFX_RTC
	depends on COUNTER && SOC_FAMILY_NRF5
	help
	  Build nRF5 RTC driver.

config RTC_0
	bool "Enable RTC 0 instance"
	depends on RTC_NRF5

if RTC_0

config RTC_0_NAME
	string "RTC 0 driver instance name"
	default "RTC_0"
	help
	  RTC_0 driver instance name

config RTC_0_IRQ_PRI
	int "RTC 0 driver Interrupt priority"
	default 1
	help
	  RTC interrupt priority.

config RTC_0_PRESCALER
	int "Value of RTC 0 counter prescaler"
	default 0
	range 0 4095
	help
	  Counter prescaler value.

endif

config RTC_1
	bool "Enable RTC 1 instance"
	depends on RTC_NRF5

if RTC_1

config RTC_1_NAME
	string "RTC1 driver instance name"
	default "RTC_1"
	help
	  RTC_1 driver instance name

config RTC_1_IRQ_PRI
	int "RTC 1 driver Interrupt priority"
	default 1
	help
	  RTC interrupt priority.

config RTC_1_PRESCALER
	int "Value of RTC 1 counter prescaler"
	default 0
	range 0 4095
	help
	  Counter prescaler value.

endif

config RTC_2
	bool "Enable RTC 2 instance"
	depends on RTC_NRF5 && SOC_SERIES_NRF52X

if RTC_2

config RTC_2_NAME
	string "RTC 2 driver instance name"
	default "RTC_2"
	help
	  RTC_2 driver instance name

config RTC_2_IRQ_PRI
	int "RTC 2 Driver Interrupt priority"
	default 1
	help
	  RTC interrupt priority.

config RTC_2_PRESCALER
	int "Value of RTC 2 counter prescaler"
	default 0
	range 0 4095
	help
	  Counter prescaler value.

endif
```
